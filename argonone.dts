// Enable Argon1 daemon by darkelvenangle
/dts-v1/;
/plugin/;

/ {
	compatible = "brcm,bcm2708";

	fragment@0 {
		target-path = "/";
		__overlay__ {
			argonone: argonone {
				label        = "argonone";
				argonone-cfg = /bits/ 8 <10 55 100 55 60 65 3>;
			};
		};
	};

	fragment@1 {
		target = <&i2c_arm>;
		__overlay__ {
			status = "okay";
		};
	};

	__overrides__ {
        fanspeed0  = <&argonone>,"argonone-cfg.0";
        fanspeed1  = <&argonone>,"argonone-cfg.1";
        fanspeed2  = <&argonone>,"argonone-cfg.2";
        fantemp0   = <&argonone>,"argonone-cfg.3";
        fantemp1   = <&argonone>,"argonone-cfg.4";
        fantemp2   = <&argonone>,"argonone-cfg.5";
		hysteresis = <&argonone>,"argonone-cfg.6";
	};
};
